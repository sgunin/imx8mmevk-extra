## conf/distro/imx8mmevk-wayland.conf
```bitbake
# DISTRO for i.MX 8M mini Evaluation kit with Wayland support and without X11

## include conf/distro/include/fsl-imx-base.inc
DISTRO = "imx8mmevk-wayland"
DISTRO_NAME = "DISTRO for i.MX 8M mini Evaluation kit with Wayland support and without X11"
DISTRO_VERSION = "4.14-sumo"
DISTRO_CODENAME = "sumo"

SDK_VENDOR = "-pokysdk"
SDK_VERSION := "${DISTRO_VERSION}"
SDK_NAME = "${DISTRO}-${TCLIBC}-${SDK_ARCH}-${IMAGE_BASENAME}-${TUNE_PKGARCH}"
SDKPATH = "/opt/${DISTRO}/${SDK_VERSION}"

TARGET_VENDOR = "-poky"

LOCALCONF_VERSION = "1"

IMX_DEFAULT_DISTRO_FEATURES = "opengl ptest multiarch bluez"

IMX_DEFAULT_EXTRA_RDEPENDS = "packagegroup-core-boot"
IMX_DEFAULT_EXTRA_RRECOMMENDS = "kernel-module-af-packet"
IMAGE_FSTYPES = "tar.bz2 ext4 sdcard.bz2"

# Enable vulkan distro feature only for mx8
IMX_DEFAULT_DISTRO_FEATURES_append_mx8 = " vulkan"
BBMASK += "meta-freescale/recipes-graphics/wayland/wayland_1.15.%.bbappend"
BBMASK += "meta-freescale/recipes-graphics/drm/libdrm_%.bbappend"
BBMASK += "poky/meta/recipes-graphics/vulkan/vulkan_1.0.65.2.bb"

#DISTRO_FEATURES_DEFAULT ?= "acl alsa argp bluetooth ext2 irda largefile pcmcia usbgadget usbhost wifi xattr nfs zeroconf pci 3g nfc x11"
#DISTRO_FEATURES_LIBC_DEFAULT ?= "ipv4 ipv6 libc-backtrace libc-big-macros libc-bsd libc-cxx-tests libc-catgets libc-charsets libc-crypt \
#                                        libc-crypt-ufc libc-db-aliases libc-envz libc-fcvt libc-fmtmsg libc-fstab libc-ftraverse \
#                                        libc-getlogin libc-idn libc-inet-anl libc-libm libc-locales libc-locale-code \
#                                        libc-memusage libc-nis libc-nsswitch libc-rcmd libc-rtld-debug libc-spawn libc-streams libc-sunrpc \
#                                        libc-utmp libc-utmpx libc-wordexp libc-posix-clang-wchar libc-posix-regexp libc-posix-regexp-glibc \
#                                        libc-posix-wchar-io"

DISTRO_FEATURES ?= "${DISTRO_FEATURES_DEFAULT} ${DISTRO_FEATURES_LIBC} ${IMX_DEFAULT_DISTRO_FEATURES}"
DISTRO_EXTRA_RDEPENDS += " ${IMX_DEFAULT_EXTRA_RDEPENDS}"
DISTRO_EXTRA_RRECOMMENDS += " ${IMX_DEFAULT_EXTRA_RRECOMMENDS}"

# Remove conflicting backends
DISTRO_FEATURES_remove = "directfb x11 "
DISTRO_FEATURES_append = " wayland pam"

TCLIBCAPPEND = ""

PREMIRRORS ??= "\
	bzr://.*/.*   http://downloads.yoctoproject.org/mirror/sources/ \n \
	cvs://.*/.*   http://downloads.yoctoproject.org/mirror/sources/ \n \
	git://.*/.*   http://downloads.yoctoproject.org/mirror/sources/ \n \
	gitsm://.*/.* http://downloads.yoctoproject.org/mirror/sources/ \n \
	hg://.*/.*    http://downloads.yoctoproject.org/mirror/sources/ \n \
	osc://.*/.*   http://downloads.yoctoproject.org/mirror/sources/ \n \
	p4://.*/.*    http://downloads.yoctoproject.org/mirror/sources/ \n \
	svn://.*/.*   http://downloads.yoctoproject.org/mirror/sources/ \n \
"

MIRRORS =+ "\
	ftp://.*/.*      http://downloads.yoctoproject.org/mirror/sources/ \n \
	http://.*/.*     http://downloads.yoctoproject.org/mirror/sources/ \n \
	https://.*/.*    http://downloads.yoctoproject.org/mirror/sources/ \n \
"

# The CONNECTIVITY_CHECK_URI's are used to test whether we can succesfully
# fetch from the network (and warn you if not). To disable the test set
# the variable to be empty.
# Git example url: git://git.yoctoproject.org/yocto-firewall-test;protocol=git;rev=master

CONNECTIVITY_CHECK_URIS ?= "https://www.example.com/"

SANITY_TESTED_DISTROS ?= " \
	poky-2.2 \n \
	poky-2.3 \n \
	poky-2.4 \n \
	ubuntu-12.04 \n \
	ubuntu-15.04 \n \
	ubuntu-16.04 \n \
	ubuntu-16.10 \n \
	ubuntu-17.04 \n \
	fedora-24 \n \
	fedora-25 \n \
	fedora-26 \n \
	centos-7 \n \
	debian-8 \n \
	debian-9 \n \
	opensuse-42.1 \n \
	opensuse-42.2 \n \
"

# Default hash policy for distro
BB_SIGNATURE_HANDLER ?= 'OEBasicHash'
#
# OELAYOUT_ABI allows us to notify users when the format of TMPDIR changes in
# an incompatible way. Such changes should usually be detailed in the commit
# that breaks the format and have been previously discussed on the mailing list
# with general agreement from the core team.
#
OELAYOUT_ABI = "11"

# add poky sanity bbclass
INHERIT += "poky-sanity"

# QA check settings - a little stricter than the OE-Core defaults
WARN_TO_ERROR_QA = "already-stripped compile-host-path install-host-path \
                    installed-vs-shipped ldflags pn-overrides rpaths staticdev \
                    useless-rpaths"
WARN_QA_remove = "${WARN_TO_ERROR_QA}"
ERROR_QA_append = " ${WARN_TO_ERROR_QA}"

## include conf/distro/include/fsl-imx-preferred-env.inc
# Use i.MX Kernel, U-Boot and Gstreamer 1.0 providers
PREFERRED_PROVIDER_virtual/bootloader_imx = "u-boot-imx"
PREFERRED_PROVIDER_virtual/kernel_imx = "linux-imx"
PREFERRED_VERSION_linux-libc-headers_imx ?= "4.14"

# Extra audio support
# Add support for ALL i.MX6/7/8 SoC families
MACHINE_EXTRA_RRECOMMENDS_append_imx = " ${@bb.utils.contains('DISTRO_FEATURES', 'alsa', 'imx-alsa-plugins', '', d)}"

# Default toolchains used in testing i.MX BSPs
DEFAULTTUNE_mx8 = "aarch64"

# Enable the kenrel loadable module as default
USE_GPU_VIV_MODULE = "1"

IMX_GPU_VERSION            ?= "6.2.4.p4.0"
IMX_GPU_VERSION_SUFFIX      = "aarch32"
IMX_GPU_VERSION_SUFFIX_mx8  = "aarch64"

PREFERRED_VERSION_imx-gpu-viv               = "${IMX_GPU_VERSION}-${IMX_GPU_VERSION_SUFFIX}"
PREFERRED_VERSION_xf86-video-imx-vivante    = "${IMX_GPU_VERSION}"
PREFERRED_VERSION_kernel-module-imx-gpu-viv = "${IMX_GPU_VERSION}"
PREFERRED_VERSION_imx-gpu-g2d               = "${IMX_GPU_VERSION}"

PREFERRED_VERSION_gstreamer1.0-plugins-base = "1.14.4.imx"
PREFERRED_VERSION_gstreamer1.0-plugins-bad  = "1.14.4.imx"
PREFERRED_VERSION_gstreamer1.0-plugins-good = "1.14.4.imx"
PREFERRED_VERSION_gstreamer1.0              = "1.14.4.imx"

# Use systemd as default init manager
VIRTUAL-RUNTIME_init_manager = "systemd"
PREFERRED_PROVIDER_udev = "systemd"
PREFERRED_PROVIDER_udev-utils = "systemd"
DISTRO_FEATURES_BACKFILL_CONSIDERED = "sysvinit"
IMX_DEFAULT_DISTRO_FEATURES += " systemd"
```

## conf/layer.conf
```bitbake
# We have a conf and classes directory, add to BBPATH
BBPATH .= ":${LAYERDIR}"

# We have a packages directory, add to BBFILES
BBFILES += "${LAYERDIR}/recipes-*/*/*.bb \
            ${LAYERDIR}/recipes-*/*/*.bbappend"

BBFILE_COLLECTIONS += "imx8mmevk-extra"
BBFILE_PATTERN_imx8mmevk-extra := "^${LAYERDIR}"
BBFILE_PRIORITY_imx8mmevk-extra = "8"
LAYERSERIES_COMPAT_imx8mmevk-extra = "sumo"

## Part from meta-sdk/conf/layer.conf  
#BBFILES_DYNAMIC += " \
#    qt5-layer:${LAYERDIR}/dynamic-layers/qt5-layer/*/*/*.bb \
#    qt5-layer:${LAYERDIR}/dynamic-layers/qt5-layer/*/*/*.bbappend \
#"
#BBMASK += "meta-freescale/dynamic-layers/qt5-layer/recipes-qt/qt5/qtbase_%.bbappend"
#BBMASK += "meta-freescale-distro/recipes-fsl/packagegroups/packagegroup-fsl-tools-gpu-external.bb"

# Part from meta-bsp/conf/layer.conf  
#BBMASK += "meta-freescale/recipes-graphics/clutter/clutter-1.0_%.bbappend"
#BBMASK += "meta-freescale/recipes-graphics/cogl/cogl-1.0_%.bbappend"
#BBMASK += "meta-freescale/recipes-graphics/imx-gpu-viv/imx-gpu-viv_5.0.11.p8.6-hfp.bb"
#BBMASK += "meta-freescale/recipes-graphics/mesa/mesa-demos_%.bbappend"
#BBMASK += "meta-freescale/recipes-graphics/xorg-driver/xf86-video-imxfb-vivante_5.0.11.p8.6.bb"

HOSTTOOLS_NONFATAL_append = " bc sha384sum xxd"

# Enable optee for all builds using this layer, assuming the machine supports it.
# To remove optee from the build, add the following line to local.conf:
# DISTRO_FEATURES_remove = "optee"
# DEPRECATED: The ability to remove optee from the build is deprecated and
# will be removed in some future release.
DISTRO_FEATURES_append = " optee"

DISTRO_FEATURES_FILTER_NATIVESDK += "wayland"

EXTRA_ROOT_PWD = "12345678"
```

## conf/local.conf
```bitbake
# Machine Selection
#
# You need to select a specific machine to target the build with.
#	
MACHINE ??= 'imx8mmevkit'

# Default policy config
#
# The distribution setting controls which policy settings are used as defaults.
# The default value is fine for general Yocto project use, at least initially.
# Ultimately when creating custom policy, people will likely end up subclassing 
# these defaults.
#
DISTRO ?= 'imx8mmevk-wayland'

# Package Management configuration
#
# This variable lists which packaging formats to enable. Multiple package backends
# can be enabled at once and the first item listed in the variable will be used
# to generate the root filesystems.
# Options are:
#  - 'package_deb' for debian style deb files
#  - 'package_ipk' for ipk files are used by opkg (a debian style embedded package manager)
#  - 'package_rpm' for rpm style packages
# E.g.: PACKAGE_CLASSES ?= "package_rpm package_deb package_ipk"
#
PACKAGE_CLASSES ?= "package_rpm"

# Additional image features
#
# The following is a list of additional classes to use when building images which
# enable extra features. Some available options which can be included in this variable
# are:
#   - 'buildstats' collect build statistics
#   - 'image-mklibs' to reduce shared library files size for an image
#   - 'image-prelink' in order to prelink the filesystem image
# NOTE: if listing mklibs & prelink both, then make sure mklibs is before prelink
# NOTE: mklibs also needs to be explicitly enabled for a given image, see local.conf.extended
#
USER_CLASSES ?= "buildstats image-mklibs image-prelink"

# By default disable interactive patch resolution (tasks will just fail instead):
#
PATCHRESOLVE = "noop"

# Disk Space Monitoring during the build
#
# Monitor the disk space during the build. If there is less that 1GB of space or less
# than 100K inodes in any key build location (TMPDIR, DL_DIR, SSTATE_DIR), gracefully
# shutdown the build. If there is less that 100MB or 1K inodes, perform a hard abort
# of the build. The reason for this is that running completely out of space can corrupt
# files and damages the build in ways which may not be easily recoverable.
# It's necesary to monitor /tmp, if there is no space left the build will fail
# with very exotic errors.
#
BB_DISKMON_DIRS ??= "\
    STOPTASKS,${TMPDIR},1G,100K \
    STOPTASKS,${DL_DIR},1G,100K \
    STOPTASKS,${SSTATE_DIR},1G,100K \
    STOPTASKS,/tmp,100M,100K \
    ABORT,${TMPDIR},100M,1K \
    ABORT,${DL_DIR},100M,1K \
    ABORT,${SSTATE_DIR},100M,1K \
    ABORT,/tmp,10M,1K"

# Qemu configuration
#
# By default qemu will build with a builtin VNC server where graphical output can be
# seen. The two lines below enable the SDL backend too. By default libsdl-native will
# be built, if you want to use your host's libSDL instead of the minimal libsdl built
# by libsdl-native then uncomment the ASSUME_PROVIDED line below.
#
PACKAGECONFIG_append_pn-qemu-native = " sdl"
PACKAGECONFIG_append_pn-nativesdk-qemu = " sdl"

# CONF_VERSION is increased each time build/conf/ changes incompatibly and is used to
# track the version of this file when it was generated. This can safely be ignored if
# this doesn't mean anything to you.
#
CONF_VERSION = "1"

# Where to place downloads
#
# During a first build the system will download many different source code tarballs
# from various upstream projects. This can take a while, particularly if your network
# connection is slow. These are all stored in DL_DIR. When wiping and rebuilding you
# can preserve this directory to speed up this part of subsequent builds. This directory
# is safe to share between multiple builds on the same machine too.
#
# The default is a downloads directory under TOPDIR which is the build directory.
#
DL_DIR ?= "${BSPDIR}/downloads/"

# Where to place shared-state files
#
# BitBake has the capability to accelerate builds based on previously built output.
# This is done using "shared state" files which can be thought of as cache objects
# and this option determines where those files are placed.
#
# You can wipe out TMPDIR leaving this directory intact and the build would regenerate
# from these files if no changes were made to the configuration. If changes were made
# to the configuration, only shared state files where the state was still valid would
# be used (done using checksums).
#
# The default is a sstate-cache directory under TOPDIR.
#
SSTATE_DIR ?= "${BSPDIR}/sstate-cache"

# Where to place the build output
#
# This option specifies where the bulk of the building work should be done and
# where BitBake should place its temporary files and output. Keep in mind that
# this includes the extraction and compilation of many applications and the toolchain
# which can use Gigabytes of hard disk space.
#
# The default is a tmp directory under TOPDIR.
#
TMPDIR = "${BSPDIR}/tmp"

# Remove old images
#
INHERIT += "rm_work"
RM_OLD_IMAGE = "1"

# To use 'firmware-imx' you need to accept the Freescale EULA
#
ACCEPT_FSL_EULA = "1"
```
